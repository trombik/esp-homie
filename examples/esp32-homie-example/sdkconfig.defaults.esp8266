## examples/esp32-homie-example/sdkconfig.defaults.esp8266
```kconfig
CONFIG_PARTITION_TABLE_TWO_OTA=y
CONFIG_MQTT_USING_ESP=y
CONFIG_USING_ESP_VFS=y
CONFIG_ENABLE_PTHREAD=y
CONFIG_MQTT_PROTOCOL_311=y
```
